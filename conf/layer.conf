## conf/layer.conf
```bitbake
# We have a conf and classes directory, add to BBPATH
BBPATH .= ":${LAYERDIR}"

# We have recipes-* directories, add to BBFILES
BBFILES += "${LAYERDIR}/recipes-*/*/*.bb \
            ${LAYERDIR}/recipes-*/*/*.bbappend"

BBFILE_COLLECTIONS += "mmrfic"
BBFILE_PATTERN_mmrfic = "^${LAYERDIR}/"
BBFILE_PRIORITY_mmrfic = "24"

LAYERDEPENDS_mmrfic = "core"
LAYERSERIES_COMPAT_mmrfic = "thud"
```

## conf/machine/am572x-bel-mmrfic.conf
```bitbake
### THIS CONFIG WILL OVERRIDE AM57XX FOR COMPATIBLE RECIPES ERROR
MACHINEOVERRIDES =. "am57xx:"

require conf/machine/include/dra7xx.inc

SOC_FAMILY_append = ":am57xx"

SERIAL_CONSOLES = "115200;ttyS2"

MULTIMEDIA_remove = "chromium-wayland"
IMAGE_INSTALL_append = " e2fsprogs-resize2fs phytec-eeprom-flashtool"
IMAGE_FSTYPES += "ext4 tar.xz"

PREFERRED_PROVIDER_virtual/kernel_${MACHINE} ??= "linux-phytec-ti"
PREFERRED_PROVIDER_virtual/bootloader_${MACHINE} = "u-boot-phytec"
PREFERRED_PROVIDER_u-boot_${MACHINE} = "u-boot-phytec"

KERNEL_DEVICETREE = "am572x-bel-mmrfic.dtb" 

# Last entry in UBOOT_CONFIG are symlinked to the default MLO and u-boot.img
UBOOT_CONFIG ?= "am572x_bel_mmrfic"

UBOOT_CONFIG[am572x_bel_mmrfic] = "am572x_bel_mmrfic_config"

CREATE_SRCIPK_pn-linux-phytec-ti ??= "1"
CREATE_SRCIPK_pn-u-boot-phytec = "1"

# Set this to the platform identifier used in BSP version for localversion
BSP_BASE_VER = "AM57xx"

# NAND/UBI configuration
MKUBIFS_ARGS = "-m 4096 -c 4083 -e 258048"
UBINIZE_ARGS = "-p 256KiB -m 4096 -s 1024"

# Set the list of device targets for ti-pdk class recipes
TI_PDK_LIMIT_SOCS ?= "am571x am572x am574x"
TI_PDK_LIMIT_BOARDS ?= "evmAM571x evmAM572x idkAM571x idkAM572x idkAM574x"
```

## conf/machine/include/am57xx-phycore-kit-dtbs.inc
```bitbake
KERNEL_DEVICETREE = "				\
	am57xx-phycore-kit.dtb			\
	am57xx-phytec-lcd-018.dtbo		\
	am57xx-phytec-vm-009.dtbo		\
	am57xx-phytec-vm-011.dtbo		\
	am57xx-phytec-wlan-wilink8.dtbo		\
	am5716-phycore-kit-10203110c.dtb	\
	am5716-phycore-kit-10203111i.dtb	\
	am5726-phycore-kit-00001100i.dtb	\
	am5726-phycore-kit-10201111i.dtb	\
	am5726-phycore-kit-40201111i.dtb	\
	am5726-phycore-kit-41201111i.dtb	\
	am5726-phycore-kit-50201111i.dtb	\
	am5728-phycore-kit-10200110i.dtb	\
	am5728-phycore-kit-40200110c.dtb	\
	am5728-phycore-kit-40a00111i.dtb	\
	am5728-phycore-kit-41300111i.dtb	\
	am5728-phycore-kit-50500111i.dtb	\
	am5729-phycore-kit-10306111i.dtb	\
	am5746-phycore-kit-11305111i.dtb	\
	am5748-phycore-kit-11304111i.dtb	\
	am5749-phycore-kit-11302111i.dtb	\
	am5749-phycore-kit-32302111i.dtb	\
"
```
